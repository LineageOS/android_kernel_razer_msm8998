## drivers/fih/Kconfig
```kconfig
menu "Device Drivers for FIH"

  config FIH_9801
  	bool "FIH 9801 project"
  	default n
  	help
  	  support fih 9801 project

  config FIH_RCL
  	bool "FIH RCL project"
  	default n
  	help
  	  support fih RCL project

  config FIH_UNUSEGPIO
       bool "fih gpio"
       default y
       help
		support fih gpio function

  config FIH_APR
           bool "fih apr"
           default n
           help
             support fih apr virtual file

  config FIH_NVRF
	  bool "fih rf nv"
	  default n
	  help
	    support fih rf nv virtual file

  config FIH_NVCUST
	  bool "fih cust nv"
	  default n
	  help
	    support fih cust nv virtual file

  config FIH_SECBOOT
	  bool "fih secboot"
	  default n
	  help
	    support fih secboot virtual file

  config FIH_FVER
	  bool "fih fver"
	  default n
	  help
	    support fih fver virtual file

  config FIH_INFO
	  bool "fih info"
	  default n
	  help
	    support fih information virtual file

  config FIH_E2P
	  bool "fih e2p"
	  default n
	  help
	    support fih e2p virtual file

  config FIH_CPU
	  bool "fih cpu"
	  default n
	  help
	    support fih cpu info virtual file

  config FIH_DRAM
	  bool "fih DRAM"
	  default n
	  help
	    support fih DRAM info virtual file

  config FIH_SUT
	  bool "fih sut"
	  default n
	  help
	    support fih sut info virtual file

  config FIH_HWID
	  bool "fih hwid"
	  default n
	  help
	    support fih hwid module

        menuconfig FIH_DEBUG
            bool "FIH DEBUG"
            default n
            help
                Turn on this group to enable FIH's DEBUG configurations menu

        if FIH_DEBUG

            config FIH_BLOG
                bool "fih bootloader log dump"
                default n
                ---help---
                    Support fih bootloader log dump

        endif

endmenu
```

## drivers/input/fingerprint/Kconfig
```kconfig
#
# Configuration for FPC
#
menuconfig FINGER_PRINT
	bool "Fingerprints"
	help
	  Say Y here, and a list of supported fingerprints will be displayed.

if FINGER_PRINT

config INPUT_FPC1020
	bool "FPC 1020 Driver"
	default n
	help
	  This is a FPC 1020 chipset Driver.

endif

#source "drivers/input/fingerprint/goodix_gfx18m/Kconfig"
```

## drivers/input/fingerprint/fpc1020_tee/Kconfig
```kconfig
config FINGERPRINT_FPC1020_TEE
	tristate "FPC1020 fingerprint reader"
	depends on INPUT_FINGERPRINT
	help
	  Say Y here to enable fingerprint sensor support.

	  If unsure, say N.

	  To compile this driver as a module, choose M here.
```

## drivers/input/touchscreen/atmel/Kconfig
```kconfig
config TOUCHSCREEN_ATMEL_MXT640T

	tristate "TOUCHSCREEN_ATMEL_MXT640T"
	depends on I2C
	default n
```

## drivers/input/touchscreen/synaptics_3708/Kconfig
```kconfig
#
# Synaptics DSX touchscreen driver configuration
#
menuconfig TOUCHSCREEN_SYNAPTICS_3708
	bool "Synaptics DSX touchscreen"
	default y
	help
	  Say Y here if you have a Synaptics DSX touchscreen connected
	  to your system.

	  If unsure, say N.

if TOUCHSCREEN_SYNAPTICS_3708

choice
	default TOUCHSCREEN_SYNAPTICS_3708_I2C
	prompt "Synaptics DSX bus interface"
config TOUCHSCREEN_SYNAPTICS_3708_I2C
	bool "RMI over I2C"
	depends on I2C
endchoice

config TOUCHSCREEN_SYNAPTICS_3708_CORE
	tristate "Synaptics DSX core driver module"
	depends on I2C || SPI_MASTER
	help
	  Say Y here to enable basic touch reporting functionality.

	  If unsure, say N.

	  To compile this driver as a module, choose M here: the
	  module will be called synaptics_3708_core.

config TOUCHSCREEN_SYNAPTICS_3708_RMI_DEV
	tristate "Synaptics DSX RMI device module"
	depends on TOUCHSCREEN_SYNAPTICS_3708_CORE
	help
	  Say Y here to enable support for direct RMI register access.

	  If unsure, say N.

	  To compile this driver as a module, choose M here: the
	  module will be called synaptics_3708_rmi_dev.

config TOUCHSCREEN_SYNAPTICS_3708_FW_UPDATE
	tristate "Synaptics DSX firmware update module"
	depends on TOUCHSCREEN_SYNAPTICS_3708_CORE
	help
	  Say Y here to enable support for doing firmware update.

	  If unsure, say N.

	  To compile this driver as a module, choose M here: the
	  module will be called synaptics_3708_fw_update.

endif
```

## drivers/platform/fih/Kconfig
```kconfig
# FIH configuration options

config MACH_FIH
	bool "FIH board"
	depends on ARCH_QCOM
	help
	 Support for FIH boards.

config MACH_FIH_MSM8998
	bool "FIH MSM8998 boards"
	depends on ARCH_MSM8998
	select MACH_FIH
	help
	 Support for FIH MSM8998 boards.

menu "FIH board selection"

config MACH_RCL
	bool "rcl board"
	select MACH_FIH_MSM8998
	help
	 Support for Razer Phone, codenamed rcl.

endmenu
```

## drivers/platform/razer/Kconfig
```kconfig
# Razer configuration options

config MACH_RAZER
	bool "Razer board"
	depends on ARCH_QCOM
	help
	 Support for Razer boards.

config MACH_RAZER_MSM8998
	bool "Razer MSM8998 boards"
	depends on ARCH_MSM8998
	select MACH_RAZER
	help
	 Support for MSM8998 Razer boards.

menu "Razer board selection"

config MACH_CHERYL
	bool "cheryl board"
	select MACH_RAZER_MSM8998
	help
	 Support for Razer Phone, codenamed cheryl.

endmenu
```
