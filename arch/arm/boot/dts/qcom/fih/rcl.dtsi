/* Copyright (c) 2013, The Linux Foundation. All rights reserved.
 *
 * This program is free software; you can redistribute it and/or modify
 * it under the terms of the GNU General Public License version 2 and
 * only version 2 as published by the Free Software Foundation.
 *
 * This program is distributed in the hope that it will be useful,
 * but WITHOUT ANY WARRANTY; without even the implied warranty of
 * MERCHANTABILITY or FITNESS FOR A PARTICULAR PURPOSE.  See the
 * GNU General Public License for more details.
 */

#include "pinctrl-msm8998.dtsi"
#include "platform-msm8998.dtsi"
#include "thermal.dtsi"
#include "power.dtsi"
#include "memmap.dtsi"
#include "touch.dtsi"
#include "camera.dtsi"
#include "audio.dtsi"
#include "rgb.dtsi"
#include "keypad.dtsi"
#include "usb-redriver.dtsi"
#include "fingerprint.dtsi"
#include "sd.dtsi"
