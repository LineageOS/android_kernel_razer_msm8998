
&soc {
  i2c@c17a000 { /* BLSP1 QUP6 (NFC) */
    /delete-node/ nq@28;
    nxp_nfc_pn547@28 {
	compatible = "nxp,nfc";
	reg = <0x28>;
	nxp,irq-gpio = <&tlmm 92 0x00>;
	nxp,ven-gpio = <&tlmm 12 0x00>;
	nxp,firm-gpio = <&tlmm 93 0x00>;
	interrupt-parent = <&tlmm>;
	interrupts = <92 0>;
	interrupt-names = "nfc_irq";
	pinctrl-names = "nfc_active","nfc_suspend";
	pinctrl-0 = <&nfc_int_active &nfc_enable_active>;
	pinctrl-1 = <&nfc_int_suspend &nfc_enable_suspend>;
    };
  };
};