/* Copyright (c) 2015, The Linux Foundation. All rights reserved.
 *
 * This program is free software; you can redistribute it and/or modify
 * it under the terms of the GNU General Public License version 2 and
 * only version 2 as published by the Free Software Foundation.
 *
 * This program is distributed in the hope that it will be useful,
 * but WITHOUT ANY WARRANTY; without even the implied warranty of
 * MERCHANTABILITY or FITNESS FOR A PARTICULAR PURPOSE.  See the
 * GNU General Public License for more details.
 */

&mdss_mdp {
	dsi_jdi_nt36850_dualmipi_cmd: qcom,mdss_dsi_jdi_wqxga_dualmipi_cmd {
		qcom,mdss-dsi-panel-name =
			"JDI Dual nt36850 cmd mode dsi panel without DSC";
		qcom,mdss-dsi-panel-type = "dsi_cmd_mode";
		qcom,mdss-dsi-panel-framerate = <60>;
		qcom,mdss-dsi-virtual-channel-id = <0>;
		fih,panel-id = <2>;//JDI_LPM053A466A_QWXGA_CMD_PANEL
		qcom,mdss-dsi-stream = <0>;
		qcom,mdss-dsi-panel-width = <720>;
		qcom,mdss-dsi-panel-height = <2560>;
		qcom,mdss-dsi-h-front-porch = <180>;
		qcom,mdss-dsi-h-back-porch = <92>;
		qcom,mdss-dsi-h-pulse-width = <20>;
		qcom,mdss-dsi-h-sync-skew = <0>;
		qcom,mdss-dsi-v-back-porch = <7>;
		qcom,mdss-dsi-v-front-porch = <8>;
		qcom,mdss-dsi-v-pulse-width = <1>;
		qcom,mdss-dsi-h-left-border = <0>;
		qcom,mdss-dsi-h-right-border = <0>;
		qcom,mdss-dsi-v-top-border = <0>;
		qcom,mdss-dsi-v-bottom-border = <0>;
		qcom,mdss-dsi-bpp = <24>;
		qcom,mdss-dsi-color-order = "rgb_swap_rgb";
		qcom,mdss-dsi-underflow-color = <0xff>;
		qcom,mdss-dsi-border-color = <0>;
		qcom,mdss-dsi-h-sync-pulse = <0>;
		qcom,mdss-dsi-traffic-mode = "non_burst_sync_event";
		qcom,mdss-dsi-bllp-eof-power-mode;
		qcom,mdss-dsi-bllp-power-mode;
		qcom,mdss-dsi-lane-0-state;
		qcom,mdss-dsi-lane-1-state;
		qcom,mdss-dsi-lane-2-state;
		qcom,mdss-dsi-lane-3-state;
		qcom,mdss-dsi-lp11-init;
		qcom,adjust-timer-wakeup-ms = <1>;
		qcom,mdss-dsi-reset-sequence = <1 10>, <0 10>, <1 10>;
		qcom,mdss-dsi-bl-max-level = <4095>;
		qcom,mdss-dsi-dma-trigger = "trigger_sw";
		qcom,mdss-dsi-mdp-trigger = "none";
		qcom,mdss-dsi-te-pin-select = <1>;
		qcom,mdss-dsi-wr-mem-start = <0x2c>;
		qcom,mdss-dsi-wr-mem-continue = <0x3c>;
		qcom,mdss-pan-physical-width-dimension = <65>;
		qcom,mdss-pan-physical-height-dimension = <117>;
		qcom,mdss-dsi-te-dcs-command = <1>;
		qcom,mdss-dsi-te-check-enable;
		qcom,mdss-dsi-te-using-te-pin;
		qcom,mdss-dsi-tx-eot-append;
		qcom,ulps-enabled;
		qcom,suspend-ulps-enabled;
		//qcom,mdss-tear-check-sync-cfg-height = <2580>;
		qcom,mdss-dsi-on-command-state = "dsi_lp_mode";
		qcom,mdss-dsi-off-command-state = "dsi_hs_mode";
		qcom,mdss-dsi-aod-8color-enter-command-state= "dsi_hs_mode";
		qcom,mdss-dsi-post-aod-8color-enter-command-state = "dsi_hs_mode";
		qcom,mdss-dsi-aod-8color-exit-command-state = "dsi_lp_mode";


		qcom,mdss-dsi-on-command = [
			15 01 00 00 00 00 02 ff 10
			39 01 00 00 00 00 03 51 ff 03
			15 01 00 00 00 00 02 53 2c
			15 01 00 00 00 00 02 35 00
			39 01 00 00 00 00 03 44 03 e8
			05 01 00 00 64 00 01 11
			05 01 00 00 00 00 01 29
		];

		//qcom,mdss-dsi-post-panel-on-command = [05 01 00 00 a0 00 01 29];

		qcom,mdss-dsi-off-command = [
			15 01 00 00 00 00 02 ff 10
			05 01 00 00 00 00 02 28 00
			05 01 00 00 3C 00 02 10 00
		];

		qcom,mdss-dsi-aod-8color-enter-command = [
			15 01 00 00 14 00 02 FF 10
			05 01 00 00 00 00 01 28
			05 01 00 00 00 00 01 39
			05 01 00 00 23 00 01 10
			15 01 00 00 00 00 02 FF 20
			15 01 00 00 00 00 02 FB 01
			15 01 00 00 00 00 02 1F 00
			15 01 00 00 00 00 02 75 02
			15 01 00 00 00 00 02 76 4E
			15 01 00 00 00 00 02 77 00
			15 01 00 00 00 00 02 78 28
			15 01 00 00 00 00 02 B3 02
			15 01 00 00 00 00 02 B4 4E
			15 01 00 00 00 00 02 B5 00
			15 01 00 00 00 00 02 B6 28
			15 01 00 00 00 00 02 FF 24
			15 01 00 00 00 00 02 FB 01
			15 01 00 00 00 00 02 6E 11
			15 01 00 00 00 00 02 95 59
			15 01 00 00 00 00 02 97 00
			15 01 00 00 00 00 02 FF 26
			15 01 00 00 00 00 02 FB 01
			15 01 00 00 00 00 02 41 43
			15 01 00 00 00 00 02 53 9F
			15 01 00 00 00 00 02 54 23
			15 01 00 00 00 00 02 55 28
			15 01 00 00 00 00 02 56 A1
			15 01 00 00 00 00 02 0A 33
			15 01 00 00 00 00 02 0B 2A
			15 01 00 00 00 00 02 0C 14
			15 01 00 00 00 00 02 0D 14
			15 01 00 00 00 00 02 11 11
			15 01 00 00 00 00 02 12 01
			15 01 00 00 00 00 02 4C 00
			15 01 00 00 00 00 02 4D 88
			15 01 00 00 00 00 02 4E 00
			15 01 00 00 00 00 02 4F 88
			15 01 00 00 00 00 02 50 05
			15 01 00 00 00 00 02 51 53
			15 01 00 00 00 00 02 58 50
			15 01 00 00 00 00 02 59 02
			15 01 00 00 00 00 02 E2 0C
			15 01 00 00 00 00 02 E3 02
			15 01 00 00 00 00 02 E7 03
			15 01 00 00 00 00 02 5A 23
			15 01 00 00 00 00 02 5E 28
			15 01 00 00 00 00 02 5F 23
			15 01 00 00 00 00 02 B1 7F
			15 01 00 00 00 00 02 B2 7F
			15 01 00 00 00 00 02 FF E0
			15 01 00 00 00 00 02 FB 01
			15 01 00 00 00 00 02 3A FC
			15 01 00 00 00 00 02 FF E0
			15 01 00 00 00 00 02 FB 01
		];

//			06 01	00 00 0a 00 01 56
//			15 01 00 00 0a 00 02 56 9X

		qcom,mdss-dsi-post-aod-8color-enter-command = [
			15 01 00 00 14 00 02 56 9A
			15 01 00 00 00 00 02 FF 10
			05 01 00 00 46 00 01 11
			15 01 00 00 00 00 02 FF 10
			05 01 00 00 0a 00 01 29
		];

		qcom,mdss-dsi-aod-8color-exit-command = [
			15 01 00 00 0a 00 02 FF 10
			05 01 00 00 00 00 01 28
			05 01 00 00 00 00 01 38
			15 01 00 00 00 00 02 FF 10
			05 01 00 00 23 00 01 10

			15 01 00 00 00 00 02 FF 20
			15 01 00 00 00 00 02 FB 00
			15 01 00 00 00 00 02 FF 21
			15 01 00 00 00 00 02 FB 00
			15 01 00 00 00 00 02 FF 24
			15 01 00 00 00 00 02 FB 00
			15 01 00 00 00 00 02 FF 26
			15 01 00 00 00 00 02 FB 00
			15 01 00 00 00 00 02 FF E0
			15 01 00 00 15 00 02 FB 00

			15 01 00 00 00 00 02 FF 10
			39 01 00 00 00 00 03 51 FF 03
			15 01 00 00 00 00 02 53 2C
			15 01 00 00 00 00 02 35 00
			39 01 00 00 00 00 03 44 03 E8
			05 01 00 00 46 00 01 11

			15 01 00 00 00 00 02 FF 10

			05 01 00 00 00 00 01 29
		];



		qcom,config-select = <&dsi_dual_nt36850_cmd_config0>;

		dsi_dual_nt36850_cmd_config0: config0 {
			qcom,split-mode = "dualctl-split";
		};

		dsi_dual_nt36850_cmd_config1: config1 {
			qcom,split-mode = "pingpong-split";
		};
	};
};
